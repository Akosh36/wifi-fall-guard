## firmware/camera/main/Kconfig.projbuild
```kconfig
menu "WiFi Fall Guard camera"

config WFG_WIFI_SSID
    string "WiFi SSID (same network as the server)"
    default "WFG-NET"

config WFG_WIFI_PASSWORD
    string "WiFi password"
    default "wfg12345"

config WFG_STATIC_IP
    string "Fixed IP address (empty = DHCP)"
    default "192.168.4.31"

config WFG_GATEWAY
    string "Gateway for the fixed IP"
    default "192.168.4.1"

config WFG_KEY
    string "Secret key (?key= in camera.snapshot_url, empty = none)"
    default ""

choice WFG_CAM_BOARD
    prompt "Camera board pinout"
    default WFG_CAM_S3_EYE
config WFG_CAM_S3_EYE
    bool "ESP32-S3-EYE / Freenove ESP32-S3-WROOM CAM / most 'ESP32-S3 CAM' N16R8 clones"
config WFG_CAM_XIAO_S3
    bool "Seeed XIAO ESP32S3 Sense"
endchoice

endmenu
```

## firmware/camera/sdkconfig.defaults
```kconfig
CONFIG_IDF_TARGET="esp32s3"
CONFIG_ESP_DEFAULT_CPU_FREQ_MHZ_240=y
CONFIG_ESPTOOLPY_FLASHSIZE_4MB=y
CONFIG_SPIRAM=y
CONFIG_SPIRAM_MODE_OCT=y
CONFIG_SPIRAM_SPEED_80M=y
```

## firmware/csi_rx/main/Kconfig.projbuild
```kconfig
menu "WiFi Fall Guard receiver"

config WFG_WIFI_SSID
    string "WiFi SSID (transmitter softAP or home router)"
    default "WFG-NET"

config WFG_WIFI_PASSWORD
    string "WiFi password"
    default "wfg12345"

config WFG_SERVER_IP
    string "Server (laptop / Raspberry Pi) IP address"
    default "192.168.4.2"
    help
        Address of the computer running `wfg serve` or `wfg record`.
        255.255.255.255 broadcasts to the whole network.

config WFG_SERVER_PORT
    int "Server UDP port"
    default 5500

config WFG_NODE_ID
    int "Node id (0, 1, 2, ...), unique per receiver"
    range 0 255
    default 0

config WFG_PING_HZ
    int "CSI sampling rate (gateway pings per second)"
    range 10 500
    default 100

endmenu
```

## firmware/csi_rx/sdkconfig.defaults
```kconfig
CONFIG_IDF_TARGET="esp32s3"
CONFIG_ESP_WIFI_CSI_ENABLED=y
CONFIG_FREERTOS_HZ=1000
CONFIG_ESP_WIFI_STATIC_RX_BUFFER_NUM=16
CONFIG_ESP_WIFI_DYNAMIC_RX_BUFFER_NUM=64
CONFIG_ESP_DEFAULT_CPU_FREQ_MHZ_240=y
CONFIG_ESPTOOLPY_FLASHSIZE_4MB=y
```

## firmware/csi_tx/main/Kconfig.projbuild
```kconfig
menu "WiFi Fall Guard transmitter"

config WFG_AP_SSID
    string "Access point SSID"
    default "WFG-NET"

config WFG_AP_PASSWORD
    string "Access point password (8+ characters, empty = open network)"
    default "wfg12345"

config WFG_AP_CHANNEL
    int "WiFi channel (keep the same in every room)"
    range 1 13
    default 6

config WFG_TX_POWER_QDBM
    int "Max transmit power in 0.25 dBm units (78 = 19.5 dBm)"
    range 8 84
    default 78

endmenu
```

## firmware/gsm_call/main/Kconfig.projbuild
```kconfig
menu "WiFi Fall Guard GSM caller"

config WFG_WIFI_SSID
    string "WiFi SSID (same network as the server)"
    default "WFG-NET"

config WFG_WIFI_PASSWORD
    string "WiFi password"
    default "wfg12345"

config WFG_STATIC_IP
    string "Fixed IP address (empty = DHCP)"
    default "192.168.4.30"
    help
        The server calls http://<this address>/call?key=..., so the address
        should not change. 192.168.4.30 suits the csi_tx network (WFG-NET).
        For a home router pick a free address in its range, or leave empty
        and reserve one in the router.

config WFG_GATEWAY
    string "Gateway for the fixed IP"
    default "192.168.4.1"

config WFG_KEY
    string "Secret key (must match ?key= in escalation.call_webhook)"
    default "change-me"

config WFG_MODEM_TX_GPIO
    int "ESP32 TX pin -> modem RXD"
    default 17

config WFG_MODEM_RX_GPIO
    int "ESP32 RX pin <- modem TXD"
    default 18

config WFG_MODEM_BAUD
    int "Modem UART baud rate"
    default 115200

config WFG_SMS_NUMBERS
    string "SMS recipients, comma separated (relatives), e.g. +998901234567,+998931234567"
    default ""

config WFG_CALL_NUMBER
    string "Number to call (empty = the number the server sends, normally 103)"
    default ""
    help
        For testing put a relative's number here.

config WFG_POLICE_NUMBER
    string "Number to call for a guard-mode (police) alarm (empty = the number the server sends, normally 102)"
    default ""
    help
        CONFIG_WFG_CALL_NUMBER is not used for police calls, so a test
        number for falls never redirects a burglary alarm. For testing put
        your own number here.

config WFG_ALLOW_EMERGENCY
    bool "Allow calling emergency numbers (101-104, 112)"
    default n
    help
        Off by default so that tests never reach real dispatchers. Turn on
        only for the finished installation.

config WFG_CALL_SECONDS
    int "How long to keep the call open (seconds)"
    range 10 900
    default 180

endmenu
```
